## CMakeLists.txt
```
if (CONFIG_ZEPHYR_ENV)

# 设置CMake最低版本限制
cmake_minimum_required(VERSION 3.8.2)
# 设置工程名
project("tls")
# 添加构建脚本biolerplate.cmake
include($ENV{ZEPHYR_BASE}/cmake/app/boilerplate.cmake NO_POLICY_SCOPE)

# 添加mbedTLS配置文件路径(!!!编译不过)
# if (CONFIG_MBEDTLS)
# target_include_directories(mbedTLS INTERFACE ${PROJECT_SOURCE_DIR}/src)
# endif()

# 添加头文件路径
include_directories(./ $ENV{MBEDTLS_BASE}/include)
# 将mbedtls源文件路径到MBEDTLS_SOURCES变量中
aux_source_directory($ENV{MBEDTLS_BASE}/library MBEDTLS_SOURCES)

# 添加依赖的.c文件，并构建名为app的可执行固件
target_sources(app PRIVATE ${MBEDTLS_SOURCES} src/main.c)

# 说明
# shell终端获取上级目录：$(dirname $(pwd))

else()
cmake_minimum_required(VERSION 3.8.2)
project("dtls")

include_directories(./ $ENV{MBEDTLS_BASE}/include)
aux_source_directory($ENV{MBEDTLS_BASE}/library MBEDTLS_SOURCES)

set(SOURCES 
	${CMAKE_CURRENT_LIST_DIR}/src/main.c 
	${MBEDTLS_SOURCES})

add_executable(tls ${SOURCES})

endif()
```

## prj.conf
```kconfig
# 使能ZEPHYR_ENV
# CONFIG_ZEPHYR_ENV=y

# General config
CONFIG_NEWLIB_LIBC=y
CONFIG_STDOUT_CONSOLE=y
CONFIG_ENTROPY_GENERATOR=y

# Networking config
CONFIG_NETWORKING=y
CONFIG_NET_IPV4=y
CONFIG_NET_TCP=y
CONFIG_NET_UDP=y

# Socket config
CONFIG_NET_SOCKETS=y
CONFIG_NET_SOCKETS_POSIX_NAMES=y

# Network DNS config
CONFIG_DNS_RESOLVER=y
CONFIG_DNS_SERVER_IP_ADDRESSES=y
CONFIG_DNS_SERVER1="114.114.114.114"

# Network address config
CONFIG_NET_CONFIG_SETTINGS=y
CONFIG_NET_CONFIG_NEED_IPV4=y
CONFIG_NET_CONFIG_MY_IPV4_ADDR="192.0.2.1"
CONFIG_NET_CONFIG_MY_IPV4_GW="192.0.2.2"

# Mbedtls config
CONFIG_MBEDTLS=y
CONFIG_MBEDTLS_BUILTIN=y
CONFIG_MBEDTLS_ENABLE_HEAP=y
CONFIG_MBEDTLS_HEAP_SIZE=4096
CONFIG_MBEDTLS_CFG_FILE="mbedtls_config.h"

CONFIG_MAIN_STACK_SIZE=2048

# Native_Posix
CONFIG_NET_L2_ETHERNET=y
CONFIG_ETH_NATIVE_POSIX=y
CONFIG_ETH_NATIVE_POSIX_RANDOM_MAC=y
```

## src/main.c
```c
/**
 ***********************************************************************************************************************
 * Copyright (c) 2020, China Mobile Communications Group Co.,Ltd.
 *
 * Licensed under the Apache License, Version 2.0 (the "License"); you may not use this file except in compliance with
 * the License. You may obtain a copy of the License at
 *
 *     http://www.apache.org/licenses/LICENSE-2.0
 *
 * Unless required by applicable law or agreed to in writing, software distributed under the License is distributed on
 * an "AS IS" BASIS, WITHOUT WARRANTIES OR CONDITIONS OF ANY KIND, either express or implied. See the License for the
 * specific language governing permissions and limitations under the License.
 *
 * @file        main.c
 *
 * @brief       main functions.
 *
 * @revision
 * Date         Author          Notes
 * 2020-07-20   XieLi           First Version
 ***********************************************************************************************************************
 */

#ifdef CONFIG_ZEPHYR_ENV
//#include <zephyr.h>
//#include <random/rand32.h>
#endif
#include <unistd.h>
#include <stdio.h>
#include <string.h>
#include <stdint.h>

#include "mbedtls/net.h"
#include "mbedtls/ssl.h"
#include "mbedtls/entropy.h"
#include "mbedtls/ctr_drbg.h"
#include "mbedtls/platform.h"
#include "ca_cert.h"

#if 0
#define SERVER_ADDR         "iotwuxi.org"
#define SERVER_PORT         "442"
#define HOST_NAME           "iotwuxi.org"
#define GET_REQUEST         "GET /index.html HTTP/1.0\r\n\r\n"
#else       
#define SERVER_ADDR         "localhost"
#define SERVER_PORT         "442"
#define HOST_NAME           "xieli.org"     /* 注意需要和证书名称中CN(Common Name)一致 */
#define GET_REQUEST         "GET /index.html HTTP/1.0\r\n\r\n"
#endif 

#if defined(MBEDTLS_DEBUG_C)
#include "mbedtls/debug.h"
#define DEBUG_THRESHOLD 4

static void my_debug(void *ctx, int level,
                     const char *file, int line, const char *str)
{
    const char *p, *basename;

    /* Extract basename from file */
    for (p = basename = file; *p != '\0'; p++)
    {
        if (*p == '/' || *p == '\\')
        {
            basename = p + 1;
        }
    }

    printf("%s:%04d: |%d| %s", basename, line, level, str);
}
#endif

/* assert_exit */
#define assert_exit(cond, ret) \
    do { if (!(cond)) { \
        printf("  !. assert: failed [line: %d, error: -0x%04X]\n", __LINE__, -ret); \
        goto cleanup; \
    } } while (0)

/**
 ***********************************************************************************************************************
 * @brief           熵源接口
 *
 * @param[in]       none
 *
 * @return          none
 ***********************************************************************************************************************
 */
static int entropy_source(void *data, uint8_t *output, size_t len, size_t *olen)
{
    uint32_t seed = 0;
    //ARG_UNUSED(data);
#ifdef CONFIG_ZEPHYR_ENV
    seed = sys_rand32_get();
#else
    seed = rand();
#endif
    if (len > sizeof(seed))
    {
        len = sizeof(seed);
    }
    memcpy(output, &seed, len);

    *olen = len;

    return 0;
}

/**
 ***********************************************************************************************************************
 * @brief           Main
 *
 * @param[in]       none
 *
 * @return          none
 ***********************************************************************************************************************
 */
void main(void)
{
#if 0
    time_t t;
    for (uint8_t i = 0; i < 16; i++)
    {
        time(&t);
        printf("t=%ld\n", t);
        sleep(1);
    }
#endif

    int ret, len = 0;
    unsigned char buf[256] = {0};
    const char *pers = "tls_client";       /* 个性化字符串 */
    mbedtls_entropy_context entropy;        /* 熵源 */
    mbedtls_ctr_drbg_context ctr_drbg;      /* 随机数 */
    //mbedtls_platform_set_printf(printf);
    //mbedtls_platform_set_snprintf(snprintf);

    mbedtls_x509_crt cert;                  /* x509证书结构体 */
    mbedtls_ssl_context ssl;                /* 网络结构体 */
    mbedtls_ssl_config conf;                /* ssl结构体 */
    mbedtls_net_context ctx;                /* ssl配置结构体 */
    mbedtls_net_init(&ctx);                 /* 初始化网络结构体 */
    mbedtls_ssl_init(&ssl);                 /* 初始化ssl结构体 */
    mbedtls_ssl_config_init(&conf);         /* 初始化ssl配置结构体 */
    mbedtls_x509_crt_init(&cert);            /* 初始化x509证书结构体 */

    /* 随机数结构体初始化 */
    mbedtls_ctr_drbg_init(&ctr_drbg);
    printf("\n  . Seeding the random number generator...");
    /* 熵源结构体初始化 */
    mbedtls_entropy_init(&entropy);
    /* 添加熵源接口，设置熵源属性 */
    mbedtls_entropy_add_source(&entropy, entropy_source, NULL, MBEDTLS_ENTROPY_MAX_GATHER, MBEDTLS_ENTROPY_SOURCE_STRONG);
    /* 根据个性化字符串更新种子 */
    ret = mbedtls_ctr_drbg_seed(&ctr_drbg, mbedtls_entropy_func, &entropy, (const uint8_t *)pers, strlen(pers));
    assert_exit(ret == 0, ret);

    printf(" ok\n  . Setting up the SSL/TLS structure...");
    /* 加载ssl默认配置选项 */
    ret = mbedtls_ssl_config_defaults(&conf, MBEDTLS_SSL_IS_CLIENT, MBEDTLS_SSL_TRANSPORT_STREAM, MBEDTLS_SSL_PRESET_DEFAULT);
    assert_exit(ret == 0, ret);

    /* 设置随机数生成器回调接口 */
    mbedtls_ssl_conf_rng(&conf, mbedtls_ctr_drbg_random, &ctr_drbg);
    /* DER格式X.509证书解析 */
    ret = mbedtls_x509_crt_parse_der(&cert, ca_cert_der, ca_cert_der_len);
    assert_exit(ret == 0, ret);

    /* 配置证书链 */
    mbedtls_ssl_conf_ca_chain(&conf, &cert, NULL);
    /* 配置认证模式 */
    mbedtls_ssl_conf_authmode(&conf, MBEDTLS_SSL_VERIFY_REQUIRED);

#if defined(MBEDTLS_DEBUG_C)
    mbedtls_debug_set_threshold(DEBUG_THRESHOLD);
    mbedtls_ssl_conf_dbg(&conf, my_debug, NULL);
#endif

    /* 通过配置选项完成ssl的设置 */
    ret = mbedtls_ssl_setup(&ssl, &conf);
    assert_exit(ret == 0, ret);

    /* 配置ssl hostname */
    ret = mbedtls_ssl_set_hostname(&ssl, HOST_NAME);
    assert_exit(ret == 0, ret);

    printf(" ok\n  . Connecting to %s:%s...", SERVER_ADDR, SERVER_PORT);
    /* 建立网络连接 */
    ret = mbedtls_net_connect(&ctx, SERVER_ADDR, SERVER_PORT, MBEDTLS_NET_PROTO_TCP);
    assert_exit(ret == 0, ret);

    /* 配置网络数据发送和接收回调接口 */
    mbedtls_ssl_set_bio(&ssl, &ctx, mbedtls_net_send, mbedtls_net_recv, NULL);
    
    printf(" ok\n  . Performing the SSL/TLS handshake...");
    /* 执行ssl握手 */
    while ((ret = mbedtls_ssl_handshake(&ssl)) != 0)    
    {
        if (ret != MBEDTLS_ERR_SSL_WANT_READ && ret != MBEDTLS_ERR_SSL_WANT_WRITE)
        {
            printf(" failed\n  ! mbedtls_ssl_handshake returned -0x%x\n\n", -ret);
            goto cleanup;
        }
    }
    
    printf(" ok\n  > Write to server:");
    /* 发送ssl应用数据 */
    ret = mbedtls_ssl_write(&ssl, (const uint8_t *)GET_REQUEST, strlen(GET_REQUEST));
    assert_exit(ret > 0, ret);
    len = ret;
    printf(" %d bytes written\n\n%s\n\n", len, GET_REQUEST);

    printf(" > Read from Server:");
    len = sizeof(buf) - 1;
    memset(buf, 0, sizeof(buf));
    do
    {
        /* 读取ssl应用数据 */
        ret = mbedtls_ssl_read(&ssl, buf, len);
    } while (ret == MBEDTLS_ERR_SSL_WANT_READ || ret == MBEDTLS_ERR_SSL_WANT_WRITE);
    assert_exit(ret > 0, ret);
    len = ret;
    printf(" %d bytes read\n\n\n%s\n\n", len, buf);

    /* 通知服务器连接即将关闭 */
    mbedtls_ssl_close_notify(&ssl);
    printf(" ok\n  . Closing the connection ... done\n");

cleanup:
    /* 释放网络结构体 */
    mbedtls_net_free(&ctx);
    /* 释放ssl结构体 */
    mbedtls_ssl_free(&ssl);
    /* 释放ssl配置结构体 */
    mbedtls_ssl_config_free(&conf);
    /* 释放随机数结构体 */
    mbedtls_ctr_drbg_free(&ctr_drbg);
    /* 释放熵结构体 */
    mbedtls_entropy_free(&entropy);
    /* 释放x509证书结构体 */
    mbedtls_x509_crt_free(&cert);
}
```

## src/ca_cert.h
```c
unsigned char ca_cert_der[] = {
  0X30, 0X82, 0X01, 0XAD, 0X30, 0X82, 0X01, 0X52, 0XA0, 0X03, 0X02, 0X01,
  0X02, 0X02, 0X02, 0X3E, 0X8B, 0X30, 0X0C, 0X06, 0X08, 0X2A, 0X86, 0X48,
  0XCE, 0X3D, 0X04, 0X03, 0X02, 0X05, 0X00, 0X30, 0X35, 0X31, 0X16, 0X30,
  0X14, 0X06, 0X03, 0X55, 0X04, 0X03, 0X13, 0X0D, 0X78, 0X69, 0X65, 0X6C,
  0X69, 0X2D, 0X52, 0X6F, 0X6F, 0X74, 0X2D, 0X43, 0X41, 0X31, 0X0E, 0X30,
  0X0C, 0X06, 0X03, 0X55, 0X04, 0X0A, 0X13, 0X05, 0X78, 0X69, 0X65, 0X6C,
  0X69, 0X31, 0X0B, 0X30, 0X09, 0X06, 0X03, 0X55, 0X04, 0X06, 0X13, 0X02,
  0X43, 0X4E, 0X30, 0X1E, 0X17, 0X0D, 0X31, 0X38, 0X30, 0X31, 0X30, 0X31,
  0X30, 0X30, 0X30, 0X30, 0X30, 0X30, 0X5A, 0X17, 0X0D, 0X32, 0X33, 0X31,
  0X32, 0X33, 0X31, 0X31, 0X31, 0X35, 0X39, 0X35, 0X39, 0X5A, 0X30, 0X35,
  0X31, 0X16, 0X30, 0X14, 0X06, 0X03, 0X55, 0X04, 0X03, 0X13, 0X0D, 0X78,
  0X69, 0X65, 0X6C, 0X69, 0X2D, 0X52, 0X6F, 0X6F, 0X74, 0X2D, 0X43, 0X41,
  0X31, 0X0E, 0X30, 0X0C, 0X06, 0X03, 0X55, 0X04, 0X0A, 0X13, 0X05, 0X78,
  0X69, 0X65, 0X6C, 0X69, 0X31, 0X0B, 0X30, 0X09, 0X06, 0X03, 0X55, 0X04,
  0X06, 0X13, 0X02, 0X43, 0X4E, 0X30, 0X59, 0X30, 0X13, 0X06, 0X07, 0X2A,
  0X86, 0X48, 0XCE, 0X3D, 0X02, 0X01, 0X06, 0X08, 0X2A, 0X86, 0X48, 0XCE,
  0X3D, 0X03, 0X01, 0X07, 0X03, 0X42, 0X00, 0X04, 0X85, 0X23, 0X7C, 0XCC,
  0XB7, 0XEE, 0X3B, 0X41, 0X1E, 0X11, 0X58, 0X41, 0X94, 0X50, 0X22, 0X5B,
  0XDB, 0XAF, 0XA2, 0XC0, 0X41, 0XD6, 0X22, 0X2C, 0X8F, 0X27, 0X8F, 0X0A,
  0XA2, 0XEE, 0X5D, 0X41, 0X39, 0XE6, 0X9A, 0X1E, 0XFC, 0X7D, 0XB8, 0XC3,
  0XF3, 0X43, 0X80, 0X99, 0XB5, 0X29, 0X27, 0X08, 0X74, 0X70, 0X62, 0XB6,
  0X6A, 0X2D, 0X2E, 0X34, 0XC5, 0X13, 0XD4, 0XFD, 0XE9, 0X05, 0XCA, 0X70,
  0XA3, 0X50, 0X30, 0X4E, 0X30, 0X0C, 0X06, 0X03, 0X55, 0X1D, 0X13, 0X04,
  0X05, 0X30, 0X03, 0X01, 0X01, 0XFF, 0X30, 0X1D, 0X06, 0X03, 0X55, 0X1D,
  0X0E, 0X04, 0X16, 0X04, 0X14, 0XCA, 0X5A, 0XE8, 0X5F, 0XB7, 0X12, 0X39,
  0XB2, 0X81, 0XC7, 0XDD, 0X13, 0XC2, 0XF8, 0XAA, 0X24, 0X22, 0X19, 0XC9,
  0X64, 0X30, 0X1F, 0X06, 0X03, 0X55, 0X1D, 0X23, 0X04, 0X18, 0X30, 0X16,
  0X80, 0X14, 0XCA, 0X5A, 0XE8, 0X5F, 0XB7, 0X12, 0X39, 0XB2, 0X81, 0XC7,
  0XDD, 0X13, 0XC2, 0XF8, 0XAA, 0X24, 0X22, 0X19, 0XC9, 0X64, 0X30, 0X0C,
  0X06, 0X08, 0X2A, 0X86, 0X48, 0XCE, 0X3D, 0X04, 0X03, 0X02, 0X05, 0X00,
  0X03, 0X47, 0X00, 0X30, 0X44, 0X02, 0X20, 0X7C, 0XD5, 0X63, 0X71, 0XFA,
  0X3F, 0X76, 0X2F, 0X1D, 0XFB, 0XD4, 0X7A, 0XEF, 0X75, 0XFA, 0XB1, 0X31,
  0X81, 0X95, 0XA1, 0X47, 0XF1, 0X25, 0XBE, 0X81, 0XE1, 0X02, 0XA9, 0X14,
  0X28, 0X19, 0X17, 0X02, 0X20, 0X0A, 0XB4, 0X1A, 0XC1, 0X54, 0X66, 0X8A,
  0X1B, 0X29, 0XC3, 0X78, 0XA8, 0XEC, 0X28, 0X4F, 0XD7, 0X4E, 0X97, 0X1E,
  0XB6, 0X7B, 0X10, 0X8B, 0X61, 0X97, 0XC3, 0XC4, 0X9C, 0XBE, 0X68, 0X06,
  0XB5
};
unsigned int ca_cert_der_len = 433;
```

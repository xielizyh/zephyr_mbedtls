## CMakeLists.txt
```
# 设置CMake最低版本限制
cmake_minimum_required(VERSION 3.8.2)
# 设置工程名
project("Base64")
# 添加构建脚本biolerplate.cmake
include($ENV{ZEPHYR_BASE}/cmake/app/boilerplate.cmake NO_POLICY_SCOPE)

# 添加mbedTLS配置文件路径(!!!编译不过)
# if (CONFIG_MBEDTLS)
# target_include_directories(mbedTLS INTERFACE ${PROJECT_SOURCE_DIR}/src)
# endif()

# 添加头文件路径
include_directories(./ $ENV{MBEDTLS_BASE}/include)
# 将mbedtls源文件路径到MBEDTLS_SOURCES变量中
aux_source_directory($ENV{MBEDTLS_BASE}/library MBEDTLS_SOURCES)

# 添加依赖的.c文件，并构建名为app的可执行固件
target_sources(app PRIVATE ${MBEDTLS_SOURCES} src/main.c)

# 说明
# shell终端获取上级目录：$(dirname $(pwd))
```

## prj.conf
```kconfig
CONFIG_ENTROPY_GENERATOR=y
CONFIG_STDOUT_CONSOLE=y

CONFIG_MBEDTLS=y
CONFIG_MBEDTLS_BUILTIN=y
CONFIG_MBEDTLS_CFG_FILE="mbedtls_config.h"
```

## src/main.c
```c
/**
 ***********************************************************************************************************************
 * Copyright (c) 2020, China Mobile Communications Group Co.,Ltd.
 *
 * Licensed under the Apache License, Version 2.0 (the "License"); you may not use this file except in compliance with
 * the License. You may obtain a copy of the License at
 *
 *     http://www.apache.org/licenses/LICENSE-2.0
 *
 * Unless required by applicable law or agreed to in writing, software distributed under the License is distributed on
 * an "AS IS" BASIS, WITHOUT WARRANTIES OR CONDITIONS OF ANY KIND, either express or implied. See the License for the
 * specific language governing permissions and limitations under the License.
 *
 * @file        main.c
 *
 * @brief       main functions.
 *
 * @revision
 * Date         Author          Notes
 * 2020-07-20   XieLi           First Version
 ***********************************************************************************************************************
 */

#include <zephyr.h>

#include <stdio.h>
#include <string.h>
#include <stdint.h>

#include "mbedtls/base64.h"
#include "mbedtls/platform.h"

static uint8_t msg[] = 
{
    0x14, 0xfb, 0x9c, 0x03, 0xd9, 0x7e
};


/**=============================================================================
 * @brief           打印
 *
 * @param[in]       none
 *
 * @return          none
 *============================================================================*/
void dump_buf(char *info, uint8_t *buf, uint32_t len)
{
    mbedtls_printf("%s", info);
    for(uint32_t i = 0; i < len; i++) {
        mbedtls_printf("%02x ", msg[i]);
    }
    mbedtls_printf("\n");
}

/**=============================================================================
 * @brief           main
 *
 * @param[in]       none
 *
 * @return          none
 *============================================================================*/
void main(void)
{
    size_t len;
    uint8_t rst[512];

    len = sizeof(msg);
    dump_buf("\n    base64 message: ", msg, len);

    mbedtls_base64_encode(rst, sizeof(rst), &len, msg, len);
    mbedtls_printf("    base64 encode[%d]: %s\n", (int)len, rst);

    mbedtls_base64_decode(rst, sizeof(rst), &len, rst, len);
    dump_buf("    base64 decode: ", rst, len);
    printf("\n");
}
```
